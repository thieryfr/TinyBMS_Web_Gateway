## main/Kconfig.projbuild
```kconfig
menu "TinyBMS Web Gateway"

menu "Infrastructure"
    config TINYBMS_EVENT_BUS_DEFAULT_QUEUE_LENGTH
        int "Default event bus queue length"
        range 1 32
        default 8
        help
            Number of events queued per subscriber before publishers start
            failing. Increase the value when subscribers may be preempted for
            extended periods or when they multiplex several streams through a
            single task.
endmenu

menu "Storage"
    config TINYBMS_HISTORY_FS_ENABLE
        bool "Enable flash history storage"
        default y

    config TINYBMS_HISTORY_FS_PARTITION_LABEL
        string "History LittleFS partition label"
        depends on TINYBMS_HISTORY_FS_ENABLE
        default "historyfs"

    config TINYBMS_HISTORY_FS_MOUNT_POINT
        string "History LittleFS mount point"
        depends on TINYBMS_HISTORY_FS_ENABLE
        default "/history"

    config TINYBMS_HISTORY_FS_FORMAT_ON_FAIL
        bool "Format LittleFS if mount fails"
        depends on TINYBMS_HISTORY_FS_ENABLE
        default n
        help
            When enabled the filesystem is formatted if mounting the history
            LittleFS partition fails. Leave disabled to avoid destructive
            operations by default.

    config TINYBMS_HISTORY_ENABLE
        bool "Enable telemetry history logging"
        depends on TINYBMS_HISTORY_FS_ENABLE
        default y

    config TINYBMS_HISTORY_DIR
        string "History directory"
        depends on TINYBMS_HISTORY_ENABLE
        default "/history"

    config TINYBMS_HISTORY_QUEUE_LENGTH
        int "History queue length"
        depends on TINYBMS_HISTORY_ENABLE
        range 8 256
        default 32

    config TINYBMS_HISTORY_TASK_STACK
        int "History logger task stack (bytes)"
        depends on TINYBMS_HISTORY_ENABLE
        range 2048 12288
        default 4096

    config TINYBMS_HISTORY_TASK_PRIORITY
        int "History logger task priority"
        depends on TINYBMS_HISTORY_ENABLE
        range 3 10
        default 4

    config TINYBMS_HISTORY_FLUSH_INTERVAL
        int "Flush interval (samples)"
        depends on TINYBMS_HISTORY_ENABLE
        range 1 1000
        default 10

    config TINYBMS_HISTORY_RETENTION_CHECK_INTERVAL
        int "Retention check interval (samples)"
        depends on TINYBMS_HISTORY_ENABLE
        range 1 10000
        default 120

    config TINYBMS_HISTORY_RETENTION_DAYS
        int "Retention period (days)"
        depends on TINYBMS_HISTORY_ENABLE
        range 0 3650
        default 30

    config TINYBMS_HISTORY_MAX_BYTES
        int "Maximum storage usage (bytes)"
        depends on TINYBMS_HISTORY_ENABLE
        range 0 8388608
        default 2097152
        help
            Maximum cumulative size of history archives stored in LittleFS.
            Set to 0 to disable size based pruning.

    config TINYBMS_HISTORY_ARCHIVE_MAX_SAMPLES
        int "Maximum samples returned per archive"
        depends on TINYBMS_HISTORY_ENABLE
        range 16 4096
        default 1024
endmenu

menu "Wi-Fi"
    config TINYBMS_WIFI_ENABLE
        bool "Enable Wi-Fi support"
        default y

    config TINYBMS_WIFI_STA_SSID
        string "Wi-Fi station SSID"
        depends on TINYBMS_WIFI_ENABLE
        default "TinyBMS"
        help
            SSID of the Wi-Fi network the gateway should connect to in station
            mode.

    config TINYBMS_WIFI_STA_PASSWORD
        string "Wi-Fi station password"
        depends on TINYBMS_WIFI_ENABLE
        default ""
        help
            Passphrase for the configured Wi-Fi network. Leave empty to connect
            to open networks.

    config TINYBMS_WIFI_STA_HOSTNAME
        string "Wi-Fi station hostname"
        depends on TINYBMS_WIFI_ENABLE
        default "tinybms-gateway"
        help
            Hostname assigned to the Wi-Fi station interface.

    config TINYBMS_WIFI_STA_MAX_RETRY
        int "Maximum connection retry attempts"
        depends on TINYBMS_WIFI_ENABLE
        range 1 50
        default 5
        help
            Number of times the station interface will attempt to reconnect
            before enabling the fallback access point.

    config TINYBMS_WIFI_AP_FALLBACK
        bool "Enable fallback access point"
        depends on TINYBMS_WIFI_ENABLE
        default y
        help
            When enabled the gateway exposes an access point if it cannot
            connect to the configured infrastructure network.

    config TINYBMS_WIFI_AP_SSID
        string "Fallback access point SSID"
        depends on TINYBMS_WIFI_AP_FALLBACK
        default "TinyBMS-Gateway"

    config TINYBMS_WIFI_AP_PASSWORD
        string "Fallback access point password"
        depends on TINYBMS_WIFI_AP_FALLBACK
        default "tinybmsgw"

    config TINYBMS_WIFI_AP_CHANNEL
        int "Fallback access point channel"
        depends on TINYBMS_WIFI_AP_FALLBACK
        range 1 13
        default 1

    config TINYBMS_WIFI_AP_MAX_CLIENTS
        int "Maximum fallback access point clients"
        depends on TINYBMS_WIFI_AP_FALLBACK
        range 1 10
        default 4
endmenu

menu "MQTT"
    config TINYBMS_MQTT_ENABLE
        bool "Enable MQTT support"
        default y

    config TINYBMS_MQTT_BROKER_URI
        string "Default MQTT broker URI"
        depends on TINYBMS_MQTT_ENABLE
        default "mqtt://tinybms.local"
        help
            URI used by default when establishing the MQTT connection. Can be
            overridden at runtime through the configuration manager.

    config TINYBMS_MQTT_USERNAME
        string "Default MQTT username"
        depends on TINYBMS_MQTT_ENABLE
        default ""

    config TINYBMS_MQTT_PASSWORD
        string "Default MQTT password"
        depends on TINYBMS_MQTT_ENABLE
        default ""

    config TINYBMS_MQTT_KEEPALIVE
        int "MQTT keepalive interval (seconds)"
        depends on TINYBMS_MQTT_ENABLE
        range 15 600
        default 60
        help
            Keepalive interval negotiated with the broker. Values outside the
            supported range will be clamped by the configuration manager.

    config TINYBMS_MQTT_DEFAULT_QOS
        int "Default MQTT QoS"
        depends on TINYBMS_MQTT_ENABLE
        range 0 2
        default 1

    config TINYBMS_MQTT_RETAIN_STATUS
        bool "Retain status publications"
        depends on TINYBMS_MQTT_ENABLE
        default y
endmenu

menu "UART"
    config TINYBMS_UART_TX_GPIO
        int "TinyBMS UART TX GPIO"
        range -1 48
        default 37
        help
            GPIO routed to the TinyBMS UART TX pad. Defaults to GPIO37 to match
            the ESP32-CAN-X2 harness but can be remapped if a different
            connector is used.

    config TINYBMS_UART_RX_GPIO
        int "TinyBMS UART RX GPIO"
        range -1 48
        default 36
        help
            GPIO routed to the TinyBMS UART RX pad. Defaults to GPIO36 to match
            the ESP32-CAN-X2 harness but can be remapped if a different
            connector is used.
endmenu

menu "CAN Publisher"
    config TINYBMS_CAN_PUBLISHER_PERIOD_MS
        int "CAN publisher period (ms)"
        range 0 60000
        default 0
        help
            Interval used to publish buffered CAN frames. Set to 0 to
            publish immediately on each TinyBMS UART update. A positive
            value enables a dedicated FreeRTOS task that republishes the
            latest frames at the configured cadence.
endmenu

menu "Victron CAN"
    config TINYBMS_CAN_VICTRON_TX_GPIO
        int "Victron CAN TX GPIO"
        range 0 48
        default 7
        help
            GPIO used as the TWAI transmit output towards the Victron bus.

    config TINYBMS_CAN_VICTRON_RX_GPIO
        int "Victron CAN RX GPIO"
        range 0 48
        default 6
        help
            GPIO used as the TWAI receive input from the Victron bus.

    config TINYBMS_CAN_KEEPALIVE_INTERVAL_MS
        int "Keepalive transmit interval (ms)"
        range 100 60000
        default 1000
        help
            Interval between keepalive frames transmitted to Victron devices.

    config TINYBMS_CAN_KEEPALIVE_TIMEOUT_MS
        int "Keepalive timeout (ms)"
        range 1000 120000
        default 10000
        help
            Time allowed between keepalive frames received from Victron
            devices before marking the link as unhealthy.

    config TINYBMS_CAN_KEEPALIVE_RETRY_MS
        int "Keepalive retry interval (ms)"
        range 100 60000
        default 500
        help
            Retry cadence used when the Victron keepalive handshake is not
            confirmed. Values lower than the transmit interval trigger faster
            retries while the link is degraded.
endmenu

endmenu
```

## sdkconfig.defaults
```kconfig
# Default SDK configuration for TinyBMS Web Gateway project
# Customize via `idf.py menuconfig` and re-run configure step

# Event bus
CONFIG_TINYBMS_EVENT_BUS_DEFAULT_QUEUE_LENGTH=32

# Security defaults
CONFIG_TINYBMS_WEB_AUTH_BASIC_ENABLE=y
CONFIG_TINYBMS_WEB_AUTH_USERNAME="admin"
CONFIG_TINYBMS_WEB_AUTH_PASSWORD="changeme"

# Storage
CONFIG_TINYBMS_HISTORY_FS_ENABLE=y
CONFIG_TINYBMS_HISTORY_FS_PARTITION_LABEL="historyfs"
CONFIG_TINYBMS_HISTORY_FS_MOUNT_POINT="/history"
CONFIG_TINYBMS_HISTORY_FS_FORMAT_ON_FAIL=n
CONFIG_TINYBMS_HISTORY_ENABLE=y
CONFIG_TINYBMS_HISTORY_DIR="/history"
CONFIG_TINYBMS_HISTORY_QUEUE_LENGTH=32
CONFIG_TINYBMS_HISTORY_TASK_STACK=4096
CONFIG_TINYBMS_HISTORY_TASK_PRIORITY=4
CONFIG_TINYBMS_HISTORY_FLUSH_INTERVAL=10
CONFIG_TINYBMS_HISTORY_RETENTION_CHECK_INTERVAL=120
CONFIG_TINYBMS_HISTORY_RETENTION_DAYS=30
CONFIG_TINYBMS_HISTORY_MAX_BYTES=2621440
CONFIG_TINYBMS_HISTORY_ARCHIVE_MAX_SAMPLES=1024

# Wifi for testing
CONFIG_TINYBMS_WIFI_STA_SSID="StarTh"
CONFIG_TINYBMS_WIFI_STA_PASSWORD="Santuario1962"


# UART defaults
# connecteur X4 pin 5 → connecteur SV1 Pin 6 → GPIO37 → TXD0
# connecteur X4 pin 4 → connecteur SV1 Pin 5 → GPIO36 → RXD0
#
CONFIG_TINYBMS_UART_TX_GPIO=37
CONFIG_TINYBMS_UART_RX_GPIO=36

# MQTT defaults
CONFIG_TINYBMS_MQTT_ENABLE=y
CONFIG_TINYBMS_MQTT_BROKER_URI="mqtt://tinybms.local"
CONFIG_TINYBMS_MQTT_USERNAME=""
CONFIG_TINYBMS_MQTT_PASSWORD=""
CONFIG_TINYBMS_MQTT_KEEPALIVE=60
CONFIG_TINYBMS_MQTT_DEFAULT_QOS=1
CONFIG_TINYBMS_MQTT_RETAIN_STATUS=y
```
