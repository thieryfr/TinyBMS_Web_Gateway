// Auto-generated from docs/tiny_rw_bms.json; do not edit manually.
static const config_manager_enum_entry_t s_enum_options_307[] = {
    {.value = 4u, .label = "4 cells"},
    {.value = 5u, .label = "5 cells"},
    {.value = 6u, .label = "6 cells"},
    {.value = 7u, .label = "7 cells"},
    {.value = 8u, .label = "8 cells"},
    {.value = 9u, .label = "9 cells"},
    {.value = 10u, .label = "10 cells"},
    {.value = 11u, .label = "11 cells"},
    {.value = 12u, .label = "12 cells"},
    {.value = 13u, .label = "13 cells"},
    {.value = 14u, .label = "14 cells"},
    {.value = 15u, .label = "15 cells"},
    {.value = 16u, .label = "16 cells"},
};

static const config_manager_enum_entry_t s_enum_options_329[] = {
    {.value = 0u, .label = "Normal"},
    {.value = 1u, .label = "Invert"},
};

static const config_manager_enum_entry_t s_enum_options_330[] = {
    {.value = 0u, .label = "Variable (Reserved)"},
    {.value = 1u, .label = "Constant Current"},
};

static const config_manager_enum_entry_t s_enum_options_331[] = {
    {.value = 0u, .label = "FET"},
    {.value = 1u, .label = "AIDO1"},
    {.value = 2u, .label = "AIDO2"},
    {.value = 3u, .label = "DIDO1"},
    {.value = 4u, .label = "DIDO2"},
    {.value = 5u, .label = "AIHO1 Active Low"},
    {.value = 6u, .label = "AIHO1 Active High"},
    {.value = 7u, .label = "AIHO2 Active Low"},
    {.value = 8u, .label = "AIHO2 Active High"},
};

static const config_manager_enum_entry_t s_enum_options_333[] = {
    {.value = 1u, .label = "Charge FET"},
    {.value = 2u, .label = "AIDO1"},
    {.value = 3u, .label = "AIDO2"},
    {.value = 4u, .label = "DIDO1"},
    {.value = 5u, .label = "DIDO2"},
    {.value = 6u, .label = "AIHO1 Active Low"},
    {.value = 7u, .label = "AIHO1 Active High"},
    {.value = 8u, .label = "AIHO2 Active Low"},
    {.value = 9u, .label = "AIHO2 Active High"},
};

static const config_manager_enum_entry_t s_enum_options_334[] = {
    {.value = 0u, .label = "Disabled"},
    {.value = 1u, .label = "AIDO1"},
    {.value = 2u, .label = "AIDO2"},
    {.value = 3u, .label = "DIDO1"},
    {.value = 4u, .label = "DIDO2"},
    {.value = 5u, .label = "AIHO1"},
    {.value = 6u, .label = "AIHO2"},
};

static const config_manager_enum_entry_t s_enum_options_335[] = {
    {.value = 1u, .label = "Internal"},
    {.value = 2u, .label = "AIDO1"},
    {.value = 3u, .label = "AIDO2"},
    {.value = 4u, .label = "DIDO1"},
    {.value = 5u, .label = "DIDO2"},
    {.value = 6u, .label = "AIHO1"},
    {.value = 7u, .label = "AIHO2"},
};

static const config_manager_enum_entry_t s_enum_options_337[] = {
    {.value = 0u, .label = "Disabled"},
    {.value = 2u, .label = "Discharge FET"},
    {.value = 3u, .label = "AIDO1"},
    {.value = 4u, .label = "AIDO2"},
    {.value = 5u, .label = "DIDO1"},
    {.value = 6u, .label = "DIDO2"},
    {.value = 7u, .label = "AIHO1 Active Low"},
    {.value = 8u, .label = "AIHO1 Active High"},
    {.value = 9u, .label = "AIHO2 Active Low"},
    {.value = 16u, .label = "AIHO2 Active High"},
};

static const config_manager_enum_entry_t s_enum_options_338[] = {
    {.value = 0u, .label = "0.1 s"},
    {.value = 1u, .label = "0.2 s"},
    {.value = 2u, .label = "0.5 s"},
    {.value = 3u, .label = "1 s"},
    {.value = 4u, .label = "2 s"},
    {.value = 5u, .label = "3 s"},
    {.value = 6u, .label = "4 s"},
    {.value = 7u, .label = "5 s"},
};

static const config_manager_enum_entry_t s_enum_options_339[] = {
    {.value = 0u, .label = "Dual 10K NTC"},
    {.value = 1u, .label = "Multipoint Active Sensor"},
};

static const config_manager_enum_entry_t s_enum_options_340[] = {
    {.value = 0u, .label = "Dual Port"},
    {.value = 1u, .label = "Single Port"},
};

static const config_manager_enum_entry_t s_enum_options_341[] = {
    {.value = 0u, .label = "FET"},
    {.value = 1u, .label = "AIDO1"},
    {.value = 2u, .label = "AIDO2"},
    {.value = 3u, .label = "DIDO1"},
    {.value = 4u, .label = "DIDO2"},
    {.value = 5u, .label = "AIHO1 Active Low"},
    {.value = 6u, .label = "AIHO1 Active High"},
    {.value = 7u, .label = "AIHO2 Active Low"},
    {.value = 8u, .label = "AIHO2 Active High"},
};

static const config_manager_enum_entry_t s_enum_options_342[] = {
    {.value = 0u, .label = "Disabled"},
    {.value = 1u, .label = "0.1 s"},
    {.value = 2u, .label = "0.2 s"},
    {.value = 3u, .label = "0.5 s"},
    {.value = 4u, .label = "1 s"},
    {.value = 5u, .label = "2 s"},
    {.value = 6u, .label = "5 s"},
    {.value = 7u, .label = "10 s"},
};

static const config_manager_enum_entry_t s_enum_options_343[] = {
    {.value = 0u, .label = "Binary"},
    {.value = 1u, .label = "ASCII"},
};

static const config_manager_register_descriptor_t s_register_descriptors[] = {
    {
        .address = 0x012C,
        .key = "fully_charged_voltage_mv",
        .label = "Fully Charged Voltage",
        .unit = "mV",
        .group = "battery",
        .comment = "Cell voltage when considered fully charged",
        .type = "uint16",
        .access = CONFIG_MANAGER_ACCESS_RW,
        .scale = 1.000000f,
        .precision = 0,
        .has_min = true,
        .min_raw = 1200u,
        .has_max = true,
        .max_raw = 4500u,
        .step_raw = 10.000000f,
        .default_raw = 3650u,
        .value_class = CONFIG_MANAGER_VALUE_NUMERIC,
        .enum_values = NULL,
        .enum_count = 0u,
    },
    {
        .address = 0x012D,
        .key = "fully_discharged_voltage_mv",
        .label = "Fully Discharged Voltage",
        .unit = "mV",
        .group = "battery",
        .comment = "Cell voltage considered fully discharged",
        .type = "uint16",
        .access = CONFIG_MANAGER_ACCESS_RW,
        .scale = 1.000000f,
        .precision = 0,
        .has_min = true,
        .min_raw = 1000u,
        .has_max = true,
        .max_raw = 3500u,
        .step_raw = 10.000000f,
        .default_raw = 3250u,
        .value_class = CONFIG_MANAGER_VALUE_NUMERIC,
        .enum_values = NULL,
        .enum_count = 0u,
    },
    {
        .address = 0x012F,
        .key = "early_balancing_threshold_mv",
        .label = "Early Balancing Threshold",
        .unit = "mV",
        .group = "battery",
        .comment = "Cell voltage threshold that enables balancing",
        .type = "uint16",
        .access = CONFIG_MANAGER_ACCESS_RW,
        .scale = 1.000000f,
        .precision = 0,
        .has_min = true,
        .min_raw = 1000u,
        .has_max = true,
        .max_raw = 4500u,
        .step_raw = 10.000000f,
        .default_raw = 3400u,
        .value_class = CONFIG_MANAGER_VALUE_NUMERIC,
        .enum_values = NULL,
        .enum_count = 0u,
    },
    {
        .address = 0x0130,
        .key = "charge_finished_current_ma",
        .label = "Charge Finished Current",
        .unit = "mA",
        .group = "battery",
        .comment = "Current threshold signalling charge completion",
        .type = "uint16",
        .access = CONFIG_MANAGER_ACCESS_RW,
        .scale = 1.000000f,
        .precision = 0,
        .has_min = true,
        .min_raw = 100u,
        .has_max = true,
        .max_raw = 5000u,
        .step_raw = 10.000000f,
        .default_raw = 1000u,
        .value_class = CONFIG_MANAGER_VALUE_NUMERIC,
        .enum_values = NULL,
        .enum_count = 0u,
    },
    {
        .address = 0x0131,
        .key = "peak_discharge_current_a",
        .label = "Peak Discharge Current Cutoff",
        .unit = "A",
        .group = "battery",
        .comment = "Instantaneous discharge protection limit",
        .type = "uint16",
        .access = CONFIG_MANAGER_ACCESS_RW,
        .scale = 1.000000f,
        .precision = 0,
        .has_min = true,
        .min_raw = 1u,
        .has_max = true,
        .max_raw = 750u,
        .step_raw = 1.000000f,
        .default_raw = 70u,
        .value_class = CONFIG_MANAGER_VALUE_NUMERIC,
        .enum_values = NULL,
        .enum_count = 0u,
    },
    {
        .address = 0x0132,
        .key = "battery_capacity_ah",
        .label = "Battery Capacity",
        .unit = "Ah",
        .group = "battery",
        .comment = "Pack capacity used for SOC calculations",
        .type = "uint16",
        .access = CONFIG_MANAGER_ACCESS_RW,
        .scale = 0.010000f,
        .precision = 2,
        .has_min = true,
        .min_raw = 10u,
        .has_max = true,
        .max_raw = 65500u,
        .step_raw = 1.000000f,
        .default_raw = 31400u,
        .value_class = CONFIG_MANAGER_VALUE_NUMERIC,
        .enum_values = NULL,
        .enum_count = 0u,
    },
    {
        .address = 0x0133,
        .key = "cell_count",
        .label = "Number of Series Cells",
        .unit = "cells",
        .group = "battery",
        .comment = "Configured number of series-connected cells",
        .type = "enum",
        .access = CONFIG_MANAGER_ACCESS_RW,
        .scale = 1.000000f,
        .precision = 0,
        .has_min = true,
        .min_raw = 4u,
        .has_max = true,
        .max_raw = 16u,
        .step_raw = 1.000000f,
        .default_raw = 16u,
        .value_class = CONFIG_MANAGER_VALUE_ENUM,
        .enum_values = s_enum_options_307,
        .enum_count = 13u,
    },
    {
        .address = 0x0134,
        .key = "allowed_disbalance_mv",
        .label = "Allowed Cell Disbalance",
        .unit = "mV",
        .group = "battery",
        .comment = "Maximum per-cell delta before alarms",
        .type = "uint16",
        .access = CONFIG_MANAGER_ACCESS_RW,
        .scale = 1.000000f,
        .precision = 0,
        .has_min = true,
        .min_raw = 15u,
        .has_max = true,
        .max_raw = 100u,
        .step_raw = 1.000000f,
        .default_raw = 15u,
        .value_class = CONFIG_MANAGER_VALUE_NUMERIC,
        .enum_values = NULL,
        .enum_count = 0u,
    },
    {
        .address = 0x0136,
        .key = "charger_startup_delay_s",
        .label = "Charger Startup Delay",
        .unit = "s",
        .group = "charger",
        .comment = "Delay before enabling the charger",
        .type = "uint16",
        .access = CONFIG_MANAGER_ACCESS_RW,
        .scale = 1.000000f,
        .precision = 0,
        .has_min = true,
        .min_raw = 5u,
        .has_max = true,
        .max_raw = 60u,
        .step_raw = 1.000000f,
        .default_raw = 20u,
        .value_class = CONFIG_MANAGER_VALUE_NUMERIC,
        .enum_values = NULL,
        .enum_count = 0u,
    },
    {
        .address = 0x0137,
        .key = "charger_disable_delay_s",
        .label = "Charger Disable Delay",
        .unit = "s",
        .group = "charger",
        .comment = "Delay before disabling charger after fault",
        .type = "uint16",
        .access = CONFIG_MANAGER_ACCESS_RW,
        .scale = 1.000000f,
        .precision = 0,
        .has_min = true,
        .min_raw = 0u,
        .has_max = true,
        .max_raw = 60u,
        .step_raw = 1.000000f,
        .default_raw = 5u,
        .value_class = CONFIG_MANAGER_VALUE_NUMERIC,
        .enum_values = NULL,
        .enum_count = 0u,
    },
    {
        .address = 0x013B,
        .key = "overvoltage_cutoff_mv",
        .label = "Over-voltage Cutoff",
        .unit = "mV",
        .group = "safety",
        .comment = "Cell voltage threshold to stop charging",
        .type = "uint16",
        .access = CONFIG_MANAGER_ACCESS_RW,
        .scale = 1.000000f,
        .precision = 0,
        .has_min = true,
        .min_raw = 1200u,
        .has_max = true,
        .max_raw = 4500u,
        .step_raw = 10.000000f,
        .default_raw = 3800u,
        .value_class = CONFIG_MANAGER_VALUE_NUMERIC,
        .enum_values = NULL,
        .enum_count = 0u,
    },
    {
        .address = 0x013C,
        .key = "undervoltage_cutoff_mv",
        .label = "Under-voltage Cutoff",
        .unit = "mV",
        .group = "safety",
        .comment = "Cell voltage threshold to stop discharging",
        .type = "uint16",
        .access = CONFIG_MANAGER_ACCESS_RW,
        .scale = 1.000000f,
        .precision = 0,
        .has_min = true,
        .min_raw = 800u,
        .has_max = true,
        .max_raw = 3500u,
        .step_raw = 10.000000f,
        .default_raw = 2800u,
        .value_class = CONFIG_MANAGER_VALUE_NUMERIC,
        .enum_values = NULL,
        .enum_count = 0u,
    },
    {
        .address = 0x013D,
        .key = "discharge_overcurrent_a",
        .label = "Discharge Over-current Cutoff",
        .unit = "A",
        .group = "safety",
        .comment = "Current limit for discharge protection",
        .type = "uint16",
        .access = CONFIG_MANAGER_ACCESS_RW,
        .scale = 1.000000f,
        .precision = 0,
        .has_min = true,
        .min_raw = 1u,
        .has_max = true,
        .max_raw = 750u,
        .step_raw = 1.000000f,
        .default_raw = 65u,
        .value_class = CONFIG_MANAGER_VALUE_NUMERIC,
        .enum_values = NULL,
        .enum_count = 0u,
    },
    {
        .address = 0x013E,
        .key = "charge_overcurrent_a",
        .label = "Charge Over-current Cutoff",
        .unit = "A",
        .group = "safety",
        .comment = "Current limit for charge protection",
        .type = "uint16",
        .access = CONFIG_MANAGER_ACCESS_RW,
        .scale = 1.000000f,
        .precision = 0,
        .has_min = true,
        .min_raw = 1u,
        .has_max = true,
        .max_raw = 750u,
        .step_raw = 1.000000f,
        .default_raw = 90u,
        .value_class = CONFIG_MANAGER_VALUE_NUMERIC,
        .enum_values = NULL,
        .enum_count = 0u,
    },
    {
        .address = 0x013F,
        .key = "overheat_cutoff_c",
        .label = "Overheat Cutoff",
        .unit = "\u00b0C",
        .group = "safety",
        .comment = "Temperature threshold to stop charging/discharging",
        .type = "uint16",
        .access = CONFIG_MANAGER_ACCESS_RW,
        .scale = 1.000000f,
        .precision = 0,
        .has_min = true,
        .min_raw = 20u,
        .has_max = true,
        .max_raw = 90u,
        .step_raw = 1.000000f,
        .default_raw = 60u,
        .value_class = CONFIG_MANAGER_VALUE_NUMERIC,
        .enum_values = NULL,
        .enum_count = 0u,
    },
    {
        .address = 0x0140,
        .key = "low_temp_charge_cutoff_c",
        .label = "Low Temperature Charge Cutoff",
        .unit = "\u00b0C",
        .group = "safety",
        .comment = "Temperature below which charging is disabled",
        .type = "int16",
        .access = CONFIG_MANAGER_ACCESS_RW,
        .scale = 1.000000f,
        .precision = 0,
        .has_min = true,
        .min_raw = -40u,
        .has_max = true,
        .max_raw = 10u,
        .step_raw = 1.000000f,
        .default_raw = 0u,
        .value_class = CONFIG_MANAGER_VALUE_NUMERIC,
        .enum_values = NULL,
        .enum_count = 0u,
    },
    {
        .address = 0x0141,
        .key = "charge_restart_level_percent",
        .label = "Charge Restart Level",
        .unit = "%",
        .group = "advanced",
        .comment = "SOC threshold to re-enable charging",
        .type = "uint16",
        .access = CONFIG_MANAGER_ACCESS_RW,
        .scale = 1.000000f,
        .precision = 0,
        .has_min = true,
        .min_raw = 60u,
        .has_max = true,
        .max_raw = 95u,
        .step_raw = 1.000000f,
        .default_raw = 80u,
        .value_class = CONFIG_MANAGER_VALUE_NUMERIC,
        .enum_values = NULL,
        .enum_count = 0u,
    },
    {
        .address = 0x0142,
        .key = "battery_max_cycles",
        .label = "Battery Maximum Cycles Count",
        .unit = "cycles",
        .group = "advanced",
        .comment = "Total cycle counter limit",
        .type = "uint16",
        .access = CONFIG_MANAGER_ACCESS_RW,
        .scale = 1.000000f,
        .precision = 0,
        .has_min = true,
        .min_raw = 10u,
        .has_max = true,
        .max_raw = 65000u,
        .step_raw = 10.000000f,
        .default_raw = 5000u,
        .value_class = CONFIG_MANAGER_VALUE_NUMERIC,
        .enum_values = NULL,
        .enum_count = 0u,
    },
    {
        .address = 0x0143,
        .key = "state_of_health_permille",
        .label = "State Of Health",
        .unit = "\u2030",
        .group = "advanced",
        .comment = "Settable SOH value",
        .type = "uint16",
        .access = CONFIG_MANAGER_ACCESS_RW,
        .scale = 0.010000f,
        .precision = 2,
        .has_min = true,
        .min_raw = 0u,
        .has_max = true,
        .max_raw = 50000u,
        .step_raw = 1.000000f,
        .default_raw = 100u,
        .value_class = CONFIG_MANAGER_VALUE_NUMERIC,
        .enum_values = NULL,
        .enum_count = 0u,
    },
    {
        .address = 0x0148,
        .key = "state_of_charge_permille",
        .label = "State Of Charge",
        .unit = "\u2030",
        .group = "advanced",
        .comment = "Manual SOC override",
        .type = "uint16",
        .access = CONFIG_MANAGER_ACCESS_RW,
        .scale = 0.010000f,
        .precision = 2,
        .has_min = true,
        .min_raw = 0u,
        .has_max = true,
        .max_raw = 50000u,
        .step_raw = 1.000000f,
        .default_raw = 40u,
        .value_class = CONFIG_MANAGER_VALUE_NUMERIC,
        .enum_values = NULL,
        .enum_count = 0u,
    },
    {
        .address = 0x0149,
        .key = "invert_ext_current_sensor",
        .label = "Invert External Current Sensor",
        .unit = "flag",
        .group = "advanced",
        .comment = "Invert external shunt polarity",
        .type = "enum",
        .access = CONFIG_MANAGER_ACCESS_RW,
        .scale = 1.000000f,
        .precision = 0,
        .has_min = false,
        .min_raw = 0u,
        .has_max = false,
        .max_raw = 0u,
        .step_raw = 0.000000f,
        .default_raw = 0u,
        .value_class = CONFIG_MANAGER_VALUE_ENUM,
        .enum_values = s_enum_options_329,
        .enum_count = 2u,
    },
    {
        .address = 0x014A,
        .key = "charger_type",
        .label = "Charger Type",
        .unit = "mode",
        .group = "system",
        .comment = "Defines charger behavior",
        .type = "enum",
        .access = CONFIG_MANAGER_ACCESS_RW,
        .scale = 1.000000f,
        .precision = 0,
        .has_min = false,
        .min_raw = 0u,
        .has_max = false,
        .max_raw = 0u,
        .step_raw = 0.000000f,
        .default_raw = 1u,
        .value_class = CONFIG_MANAGER_VALUE_ENUM,
        .enum_values = s_enum_options_330,
        .enum_count = 2u,
    },
    {
        .address = 0x014B,
        .key = "load_switch_type",
        .label = "Load Switch Type",
        .unit = "mode",
        .group = "system",
        .comment = "Output used for load switching",
        .type = "enum",
        .access = CONFIG_MANAGER_ACCESS_RW,
        .scale = 1.000000f,
        .precision = 0,
        .has_min = false,
        .min_raw = 0u,
        .has_max = false,
        .max_raw = 0u,
        .step_raw = 0.000000f,
        .default_raw = 0u,
        .value_class = CONFIG_MANAGER_VALUE_ENUM,
        .enum_values = s_enum_options_331,
        .enum_count = 9u,
    },
    {
        .address = 0x014C,
        .key = "automatic_recovery_count",
        .label = "Automatic Recovery Attempts",
        .unit = "count",
        .group = "system",
        .comment = "Number of automatic recovery tries",
        .type = "uint16",
        .access = CONFIG_MANAGER_ACCESS_RW,
        .scale = 1.000000f,
        .precision = 0,
        .has_min = true,
        .min_raw = 1u,
        .has_max = true,
        .max_raw = 30u,
        .step_raw = 1.000000f,
        .default_raw = 5u,
        .value_class = CONFIG_MANAGER_VALUE_NUMERIC,
        .enum_values = NULL,
        .enum_count = 0u,
    },
    {
        .address = 0x014D,
        .key = "charger_switch_type",
        .label = "Charger Switch Type",
        .unit = "mode",
        .group = "system",
        .comment = "Output controlling the charger",
        .type = "enum",
        .access = CONFIG_MANAGER_ACCESS_RW,
        .scale = 1.000000f,
        .precision = 0,
        .has_min = false,
        .min_raw = 0u,
        .has_max = false,
        .max_raw = 0u,
        .step_raw = 0.000000f,
        .default_raw = 1u,
        .value_class = CONFIG_MANAGER_VALUE_ENUM,
        .enum_values = s_enum_options_333,
        .enum_count = 9u,
    },
    {
        .address = 0x014E,
        .key = "ignition_source",
        .label = "Ignition Source",
        .unit = "mode",
        .group = "system",
        .comment = "Input used to sense ignition",
        .type = "enum",
        .access = CONFIG_MANAGER_ACCESS_RW,
        .scale = 1.000000f,
        .precision = 0,
        .has_min = false,
        .min_raw = 0u,
        .has_max = false,
        .max_raw = 0u,
        .step_raw = 0.000000f,
        .default_raw = 0u,
        .value_class = CONFIG_MANAGER_VALUE_ENUM,
        .enum_values = s_enum_options_334,
        .enum_count = 7u,
    },
    {
        .address = 0x014F,
        .key = "charger_detection_source",
        .label = "Charger Detection Source",
        .unit = "mode",
        .group = "system",
        .comment = "Source used to detect presence of charger",
        .type = "enum",
        .access = CONFIG_MANAGER_ACCESS_RW,
        .scale = 1.000000f,
        .precision = 0,
        .has_min = false,
        .min_raw = 0u,
        .has_max = false,
        .max_raw = 0u,
        .step_raw = 0.000000f,
        .default_raw = 1u,
        .value_class = CONFIG_MANAGER_VALUE_ENUM,
        .enum_values = s_enum_options_335,
        .enum_count = 7u,
    },
    {
        .address = 0x0151,
        .key = "precharge_pin",
        .label = "Precharge Output",
        .unit = "mode",
        .group = "system",
        .comment = "Output used to precharge the contactor",
        .type = "enum",
        .access = CONFIG_MANAGER_ACCESS_RW,
        .scale = 1.000000f,
        .precision = 0,
        .has_min = false,
        .min_raw = 0u,
        .has_max = false,
        .max_raw = 0u,
        .step_raw = 0.000000f,
        .default_raw = 0u,
        .value_class = CONFIG_MANAGER_VALUE_ENUM,
        .enum_values = s_enum_options_337,
        .enum_count = 10u,
    },
    {
        .address = 0x0152,
        .key = "precharge_duration",
        .label = "Precharge Duration",
        .unit = "s",
        .group = "system",
        .comment = "Duration of precharge before closing main contactor",
        .type = "enum",
        .access = CONFIG_MANAGER_ACCESS_RW,
        .scale = 1.000000f,
        .precision = 1,
        .has_min = false,
        .min_raw = 0u,
        .has_max = false,
        .max_raw = 0u,
        .step_raw = 0.000000f,
        .default_raw = 7u,
        .value_class = CONFIG_MANAGER_VALUE_ENUM,
        .enum_values = s_enum_options_338,
        .enum_count = 8u,
    },
    {
        .address = 0x0153,
        .key = "temperature_sensor_type",
        .label = "Temperature Sensor Type",
        .unit = "mode",
        .group = "system",
        .comment = "Defines type of connected temp sensors",
        .type = "enum",
        .access = CONFIG_MANAGER_ACCESS_RW,
        .scale = 1.000000f,
        .precision = 0,
        .has_min = false,
        .min_raw = 0u,
        .has_max = false,
        .max_raw = 0u,
        .step_raw = 0.000000f,
        .default_raw = 0u,
        .value_class = CONFIG_MANAGER_VALUE_ENUM,
        .enum_values = s_enum_options_339,
        .enum_count = 2u,
    },
    {
        .address = 0x0154,
        .key = "operation_mode",
        .label = "BMS Operation Mode",
        .unit = "mode",
        .group = "system",
        .comment = "Dual or single port operation",
        .type = "enum",
        .access = CONFIG_MANAGER_ACCESS_RW,
        .scale = 1.000000f,
        .precision = 0,
        .has_min = false,
        .min_raw = 0u,
        .has_max = false,
        .max_raw = 0u,
        .step_raw = 0.000000f,
        .default_raw = 0u,
        .value_class = CONFIG_MANAGER_VALUE_ENUM,
        .enum_values = s_enum_options_340,
        .enum_count = 2u,
    },
    {
        .address = 0x0155,
        .key = "single_port_switch_type",
        .label = "Single Port Switch Type",
        .unit = "mode",
        .group = "system",
        .comment = "Output used when operating in single-port mode",
        .type = "enum",
        .access = CONFIG_MANAGER_ACCESS_RW,
        .scale = 1.000000f,
        .precision = 0,
        .has_min = false,
        .min_raw = 0u,
        .has_max = false,
        .max_raw = 0u,
        .step_raw = 0.000000f,
        .default_raw = 0u,
        .value_class = CONFIG_MANAGER_VALUE_ENUM,
        .enum_values = s_enum_options_341,
        .enum_count = 9u,
    },
    {
        .address = 0x0156,
        .key = "broadcast_interval",
        .label = "Broadcast Interval",
        .unit = "mode",
        .group = "system",
        .comment = "UART broadcast period",
        .type = "enum",
        .access = CONFIG_MANAGER_ACCESS_RW,
        .scale = 1.000000f,
        .precision = 0,
        .has_min = false,
        .min_raw = 0u,
        .has_max = false,
        .max_raw = 0u,
        .step_raw = 0.000000f,
        .default_raw = 0u,
        .value_class = CONFIG_MANAGER_VALUE_ENUM,
        .enum_values = s_enum_options_342,
        .enum_count = 8u,
    },
    {
        .address = 0x0157,
        .key = "communication_protocol",
        .label = "Communication Protocol",
        .unit = "mode",
        .group = "system",
        .comment = "Protocol used on UART port",
        .type = "enum",
        .access = CONFIG_MANAGER_ACCESS_RW,
        .scale = 1.000000f,
        .precision = 0,
        .has_min = false,
        .min_raw = 0u,
        .has_max = false,
        .max_raw = 0u,
        .step_raw = 0.000000f,
        .default_raw = 1u,
        .value_class = CONFIG_MANAGER_VALUE_ENUM,
        .enum_values = s_enum_options_343,
        .enum_count = 2u,
    },
};

static const size_t s_register_count = sizeof(s_register_descriptors) / sizeof(s_register_descriptors[0]);